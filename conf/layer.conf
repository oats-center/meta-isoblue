## conf/layer.conf
```bitbake
# We have a conf and classes directory, append to BBPATH
BBPATH .= ":${LAYERDIR}"

# We have recipes-* directories, add to BBFILES
BBFILES += "${LAYERDIR}/recipes-*/*/*.bb ${LAYERDIR}/recipes-*/*/*.bbappend"

BBFILE_COLLECTIONS += "isoblue-layer"
BBFILE_PATTERN_isoblue-layer = "^${LAYERDIR}/"
BBFILE_PRIORITY_isoblue-layer = "90"

#TODO: need to add dependencies
LAYERDEPENDS_isoblue-layer = " \
    core \
    openembedded-layer \
"
```
